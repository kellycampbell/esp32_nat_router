## main/Kconfig.projbuild
```kconfig
menu "Example Configuration"

    config STORE_HISTORY
        bool "Store command history in flash"
        default y
        help
            Linenoise line editing library provides functions to save and load
            command history. If this option is enabled, initalizes a FAT filesystem
            and uses it to store command history.

endmenu

menu "WiFi Repeater"

    config REPEATER_MODE
        bool "Enable L2 WiFi AP-STA repeater mode"
        default n
        help
            When enabled, the ESP32 acts as a true L2 bridge between the
            upstream WiFi STA and the downstream WiFi AP: no NAPT, no
            AP-side DHCP server. AP clients receive DHCP leases from the
            upstream server via Option 61 proxying and live on the
            upstream subnet. The ESP32 itself takes a single IP on that
            subnet via its STA; all local services (web UI, console,
            OTA) bind to that IP.

            When disabled, the firmware behaves as a traditional NAT
            router (NAPT + AP-side DHCPS).

    config HALOW_UPLINK
        bool "Use a Wi-Fi HaLow transceiver as the upstream link"
        default n
        help
            Drive the upstream side of the bridge from a Morse Micro Wi-Fi
            HaLow transceiver (802.11ah, sub-GHz) instead of the native
            Wi-Fi STA. The native radio then runs AP-only for downstream
            clients, so the two sides no longer share a radio and the AP is
            free of the channel-lock constraint.

            Requires the morsemicro/halow managed component and a board
            profile supplying the SPI pin map, chip variant and BCF file.
            See sdkconfig.defaults.halow.

            Note that the HaLow side supports only open, OWE and WPA3-SAE
            security; WPA2-PSK and WPA2-Enterprise are not available on the
            uplink in this mode.

endmenu

menu "MQTT Home Assistant"

    config MQTT_HOMEASSISTANT
        bool "Enable MQTT Home Assistant integration"
        default y
        help
            Publishes router telemetry to an MQTT broker with
            Home Assistant auto-discovery. Adds ~58 KB flash.
            RAM is only used when a broker is configured and enabled.

    config MQTT_HA_BUFFER_SIZE
        int "MQTT buffer size (bytes)"
        default 1024
        depends on MQTT_HOMEASSISTANT

    config MQTT_DEFAULT_INTERVAL
        int "Default publish interval (seconds)"
        default 30
        depends on MQTT_HOMEASSISTANT
        range 5 3600

endmenu
```
